//*********************************************************************
//
//           版权所有 (C), 2008-2028, 格物互动文化传播有限公司
//             -----------------------------------------------
//
//  文件作者:   liu-PC
//  生成日期:
//  功能描述:
//  修改历史:
//  (1)   修改日期:
//  (2)   修改作者:Liu-PC
//  (3)   修改内容:
//  [4]   微信:lpc17707020887    LiuPC
//*********************************************************************


#include "Rs485.h"

static void RS485_Set_Tx(void);
static void RS485_Set_Rx(void);


DEVICE_DEFINE(RS485_0,DEVICE_TWO)



/**********************************************************************
** 函数名称         :
** 创建人           :
** 创建日期         :
** 最新修改人       :
** 最近修改日期     :
** 功能描述         :
** 入口参数         :
												--NONE
** 返回参数         :
												--NONE
** 备注/注意        :
** 微信              :lpc17707020887    LiuPC
***********************************************************************/
DEVICE_FUNC_DEFINE_OPEN(RS485_0)
{
    RS485_Set_Rx();
    return DEV_OK;
}


/**********************************************************************
** 函数名称         :
** 创建人           :
** 创建日期         :
** 最新修改人       :
** 最近修改日期     :
** 功能描述         :
** 入口参数         :
												--NONE
** 返回参数         :
												--NONE
** 备注/注意        :
** 微信              :lpc17707020887    LiuPC
***********************************************************************/
DEVICE_FUNC_DEFINE_CLOSE(RS485_0)
{


	return DEV_OK;
}



/**********************************************************************
** 函数名称         :
** 创建人           :
** 创建日期         :
** 最新修改人       :
** 最近修改日期     :
** 功能描述         :
** 入口参数         :
												--NONE
** 返回参数         :
												--NONE
** 备注/注意        :
** 微信              :lpc17707020887    LiuPC
***********************************************************************/
DEVICE_FUNC_DEFINE_READ(RS485_0)
{
    RS485_Recieve_Data((uint8_t*)buf,len);
	return DEV_OK;
}

/**********************************************************************
** 函数名称         :
** 创建人           :
** 创建日期         :
** 最新修改人       :
** 最近修改日期     :
** 功能描述         :
** 入口参数         :
												--NONE
** 返回参数         :
												--NONE
** 备注/注意        :
** 微信              :lpc17707020887    LiuPC
***********************************************************************/
DEVICE_FUNC_DEFINE_WRITE(RS485_0)
{

    RS485_Send_Data((uint8_t *)buf,len);

	return DEV_OK;
}


/**********************************************************************
** 函数名称         :
** 创建人           :
** 创建日期         :
** 最新修改人       :
** 最近修改日期     :
** 功能描述         :
** 入口参数         :
												--NONE
** 返回参数         :
												--NONE
** 备注/注意        :
** 微信              :lpc17707020887    LiuPC
***********************************************************************/
DEVICE_FUNC_DEFINE_LSEEK(RS485_0)
{



	return DEV_OK;
}


/**********************************************************************
** 函数名称         :
** 创建人           :
** 创建日期         :
** 最新修改人       :
** 最近修改日期     :
** 功能描述         :
** 入口参数         :
												--NONE
** 返回参数         :
												--NONE
** 备注/注意        :
** 微信              :lpc17707020887    LiuPC
***********************************************************************/
DEVICE_FUNC_DEFINE_IOCTL(RS485_0)
{
    switch((Rs485_Ctl_Cmd_Typedef)cmd)
    {
            case CMD_SEND_Or_RECEIVE:       //具体调用举例：DEV_Ioctl(DEVICE_TWO, CMD_SEND_Or_RECEIVE, Direction_Input);
            {
                Rs485_Flow_Direction_Typedef enum_rs485_direction;
                enum_rs485_direction = (Rs485_Flow_Direction_Typedef) va_arg(*args_temp,uint8_t);

                if(enum_rs485_direction == Direction_Output)
                {
                        RS485_Set_Rx();
                }
                else if(enum_rs485_direction == Direction_Input)
                {
                        RS485_Set_Tx();
                }
            }
            default:
            {

            }break;
    }
    return DEV_OK;
}




#define RXBUFFER_SIZE 1

uint8_t g_RxBuf[RXBUFFER_SIZE];



/**********************************************************************
** 函数名称         :
** 创建人           :
** 创建日期         :
** 最新修改人       :
** 最近修改日期     :
** 功能描述         :
** 入口参数         :
												--NONE
** 返回参数         :
												--NONE
** 备注/注意        :
** 微信              :lpc17707020887    LiuPC
***********************************************************************/
void RS485_Set_Tx(void)
{
    HAL_GPIO_WritePin(SW_Of_T_R_GPIO_Port, SW_Of_T_R_Pin, GPIO_PIN_SET);
}




/**********************************************************************
** 函数名称         :
** 创建人           :
** 创建日期         :
** 最新修改人       :
** 最近修改日期     :
** 功能描述         :
** 入口参数         :
												--NONE
** 返回参数         :
												--NONE
** 备注/注意        :
** 微信              :lpc17707020887    LiuPC
***********************************************************************/
static void RS485_Set_Rx(void)
{
    HAL_GPIO_WritePin(SW_Of_T_R_GPIO_Port, SW_Of_T_R_Pin, GPIO_PIN_RESET);
}




/**********************************************************************
** 函数名称         :
** 创建人           :
** 创建日期         :
** 最新修改人       :
** 最近修改日期     :
** 功能描述         :
** 入口参数         :
												--NONE
** 返回参数         :
												--NONE
** 备注/注意        :
** 微信              :lpc17707020887    LiuPC
***********************************************************************/
void RS485_Recieve_Data(const uint8_t *srcbuf, uint32_t len)
{

    while (len > 0)
    {
            g_RxBuf[len] = srcbuf[--len];
    }
}




/**********************************************************************
** 函数名称         :
** 创建人           :
** 创建日期         :
** 最新修改人       :
** 最近修改日期     :
** 功能描述         :
** 入口参数         :
												--NONE
** 返回参数         :
												--NONE
** 备注/注意        :
** 微信              :lpc17707020887    LiuPC
***********************************************************************/
void RS485_Send_Data(uint8_t *buf, uint8_t len)
{
    RS485_Set_Tx();

        while (len--)
        {
                USART3_Putchar(*buf);
                buf++;
        }

        g_RxBuf[0] = 0;

    RS485_Set_Rx();
}




/**********************************************************************
** 函数名称         :
** 创建人           :
** 创建日期         :
** 最新修改人       :
** 最近修改日期     :
** 功能描述         :RS485测试函数
** 入口参数         :
												--NONE
** 返回参数         :
												--NONE
** 备注/注意        :
** 微信              :lpc17707020887    LiuPC
***********************************************************************/
void RS485_Rsp_test()
{
    RS485_Send_Data(g_RxBuf, 1);
    g_RxBuf[0] = 0;
}



